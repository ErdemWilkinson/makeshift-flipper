## c6-firmware/main/Kconfig.projbuild
```kconfig
menu "Makeshift Flipper C6 -- Error Log"

    config MAKESHIFT_LOG_SERVER_HOST
        string "Log server host (PC's LAN IP or hostname)"
        default "192.168.4.27"
        help
            Where the log server helper (c6-firmware/tools/debug_server.py)
            runs on the local network. Used by the on-device "Errors" ->
            Send feature to upload the device's local error history for
            safekeeping/inspection on a PC -- no AI/Ollama involved, just a
            small HTTP endpoint that appends the uploaded entries to a
            file. Entirely optional: the error history works fully offline
            on the device without this being configured at all.

    config MAKESHIFT_LOG_SERVER_PORT
        int "Log server port"
        default 8765
        help
            Must match PORT in debug_server.py.

endmenu
```
